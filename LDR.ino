/*
  Written by Mmontsheng Maoto
  Email Address : mmontshengmaoto@gmail.com
  Year : 2017

  Code Description:
  This code is used to control lights using a remote,IR reciver(38Khz module) and LDR.


  External Libraries
  #include <boarddefs.h>
  #include <IRremote.h>
  #include <IRremoteInt.h>
  #include <ir_Lego_PF_BitStreamEncoder.h>

  can be found on github
*/

// LCD library
#include <LiquidCrystal.h>

// IR library
#include <boarddefs.h>
#include <IRremote.h>
#include <IRremoteInt.h>
#include <ir_Lego_PF_BitStreamEncoder.h>

//digital pins for lights
#define lightOne 6
#define lightTwo 7
#define lightThree 8
// LED will always be ON to show that the controller is functioning properly
#define microcontrollerStatusLed 13
// codes generated by the button button on the remote, refer to the IRrecvDemo in the IR library
// The IRrecvDemo will give you the keycode in Hex, convert the codes to digital numbering systems
#define changeAutoSatusRemoteCode 948321234
#define lightOneRemoteCode 948321248
#define lightTwoRemoteCode 948321232
#define lightThreeRemoteCode 948321264

//  initial status of the lights when program loads
volatile int lightOneStatus = HIGH;
volatile int lightTwoStatus = HIGH;
volatile int lightThreeStatus = HIGH;

// lights will turn on automatically when it's dark
volatile int automateLight = HIGH;

// LDR sensor pin
// connect a pull down resistor next to this pin, 10K should be fine

const int analogPin = 3;
// variable used to hold the value of analogue pin 3
// the controller has a 10 bit ADC, thus values range from 0 to 1023.
// I considered a value above 1000 as a HIGH, below  1000 is a logic LOW

int LDR_Value;
// Convert the analog reading (which goes from 0 - 1023) to a voltage (0 - 5V):
float voltage ;

//IR receiver pin
const int RECV_PIN = 9;
IRrecv  irrecv(RECV_PIN);
decode_results results;

// initialize the library with the numbers of the interface pins
LiquidCrystal lcd(12, 11, 5, 4, 3, 2);

// I'm jsut fonna write those comments "Program does not work without this variable"
// Variable use to controlled code execution in the void loop function
// trying to run the code once
boolean isChanged = false;

void setup()
{

  LDR_Value = analogRead(analogPin);
  // Convert the analog reading (which goes from 0 - 1023) to a voltage (0 - 5V):
  voltage = LDR_Value * (5.0 / 1023.0);

  // set up the LCD's number of columns and rows:
  lcd.begin(16, 2);
  onStart();

  Serial.begin(9600);

  // Start the receiver
  irrecv.enableIRIn();
  pinMode(microcontrollerStatusLed, OUTPUT);
  pinMode(lightOne, OUTPUT);
  pinMode(lightTwo, OUTPUT);
  pinMode(lightThree, OUTPUT);
  pinMode(analogPin, INPUT);

  // automate();

}

void loop()
{
  digitalWrite(microcontrollerStatusLed, HIGH);

  LDR_Value = analogRead(analogPin);
  // Convert the analog reading (which goes from 0 - 1023) to a voltage (0 - 5V):
  voltage = LDR_Value * (5.0 / 1023.0);

  if (irrecv.decode(&results)) {
    long int decCode =  results.value;
    if ( decCode == changeAutoSatusRemoteCode) {
      automate();
      if (automateLight == LOW) {
        toggleLights();
      }
      if (automateLight == HIGH) {
        onStart();
      }


    }
    if (automateLight == LOW) {//
      if ((decCode == lightOneRemoteCode || decCode == lightTwoRemoteCode || decCode == lightThreeRemoteCode) ) {

        switchOnOrOffLightsUsingRemote(decCode);
        toggleLights();


      }
    }
    // Receive the next value
    irrecv.resume();
  }



  // switch on automatically
  if (voltage < 3 && automateLight == HIGH) {

    //switch on lights and chance status

    digitalWrite(lightOne, HIGH);
    digitalWrite(lightTwo, HIGH);
    digitalWrite(lightThree, HIGH);
    lightOneStatus = HIGH;
    lightTwoStatus = HIGH;
    lightThreeStatus = HIGH;
    //find a way to call this func once
    if (isChanged == false) {
      onStart();
      isChanged = true;
    }


  }

  if (automateLight == HIGH && voltage >= 3 ) {

    digitalWrite(lightOne, LOW);
    digitalWrite(lightTwo, LOW);
    digitalWrite(lightThree, LOW);

    lightOneStatus = LOW;
    lightTwoStatus = LOW;
    lightThreeStatus = LOW;

    if (isChanged == true) {
      onStart();
      isChanged = false;
    }
  }
}


void automate()
{
  automateLight = !automateLight;

  if (automateLight == HIGH && voltage < 3) {
    lcd.begin(16, 2);
    lightOneStatus = HIGH;
    lightTwoStatus = HIGH;
    lightThreeStatus = HIGH;
    lcd.clear();
    lcd.print("AUTOMATIC SWITCH");
    lcd.setCursor(0, 1);
    lcd.print("ON LIGHTS:1,2,3");


  }
  if (automateLight == HIGH && voltage >= 3) {

    digitalWrite(lightOne, LOW);
    digitalWrite(lightTwo, LOW);
    digitalWrite(lightThree, LOW);

    lightOneStatus = LOW;
    lightTwoStatus = LOW;
    lightThreeStatus = LOW;

  }
}


// switch on and off the lights
// input parameter: the code generate by the buttons on the remote
void switchOnOrOffLightsUsingRemote(long int decCode) {

  if (decCode == lightOneRemoteCode &&  lightOneStatus == HIGH ) {
    // switch off light
    digitalWrite(lightOne, LOW);
    lightOneStatus = LOW;
    decCode = 0;

  } if (decCode == lightOneRemoteCode &&  lightOneStatus == LOW ) {
    // switch on light
    digitalWrite(lightOne, HIGH);
    lightOneStatus = HIGH;
    decCode = 0;
  }


  if (decCode == lightTwoRemoteCode  && lightTwoStatus == HIGH ) {
    // switch off light
    digitalWrite(lightTwo, LOW);
    lightTwoStatus = LOW;


    decCode = 0;
  } if (decCode == lightTwoRemoteCode && lightTwoStatus == LOW ) {
    // switch on light
    digitalWrite(lightTwo, HIGH);
    lightTwoStatus = HIGH;
    decCode = 0;
  }

  if (decCode == lightThreeRemoteCode && lightThreeStatus == HIGH ) {
    // switch off light
    digitalWrite(lightThree, LOW);
    lightThreeStatus = LOW;
    decCode = 0;
  } if (decCode == lightThreeRemoteCode && lightThreeStatus == LOW ) {
    // switch on light
    digitalWrite(lightThree, HIGH);
    lightThreeStatus = HIGH;
    decCode = 0;
  }

}


void toggleLights() {
  lcd.begin(16, 2);
  lcd.clear();
  lcd.print("MANUAL SWITCH");
  lcd.setCursor(0, 1);
  // 16 space characters
  //ensures that code is printed on the line in the 16*2 LCD
  lcd.print("                ");

  if (lightOneStatus == HIGH) {
    lcd.setCursor(0, 1);
    // print the number of seconds since reset:
    lcd.print("ON LIGHT:1");
  }

  if (lightTwoStatus == HIGH) {
    lcd.setCursor(0, 1);
    // print the number of seconds since reset:
    lcd.print("ON LIGHT:2");
  }

  if (lightThreeStatus == HIGH) {
    lcd.setCursor(0, 1);
    // print the number of seconds since reset:
    lcd.print("ON LIGHT:3");
  }
  if (lightOneStatus == HIGH && lightTwoStatus == HIGH ) {
    lcd.setCursor(0, 1);
    // print the number of seconds since reset:
    lcd.print("ON LIGHTS:1,2");
  }
  if (lightOneStatus == HIGH && lightThreeStatus == HIGH ) {
    lcd.setCursor(0, 1);
    // print the number of seconds since reset:
    lcd.print("ON LIGHTS:1,3");
  }
  if (lightTwoStatus == HIGH && lightThreeStatus == HIGH ) {
    lcd.setCursor(0, 1);
    // print the number of seconds since reset:
    lcd.print("ON LIGHTS:2,3");
  }
  if (lightOneStatus == HIGH && lightTwoStatus == HIGH && lightThreeStatus == HIGH ) {
    lcd.setCursor(0, 1);
    // print the number of seconds since reset:
    lcd.print("ON LIGHTS:1,2,3");
  }

  if (lightOneStatus == LOW && lightTwoStatus == LOW && lightThreeStatus == LOW ) {
    lcd.setCursor(0, 1);
    // print the number of seconds since reset:
    lcd.print("ON LIGHTS:NONE");
  }
}

// will run in void setup when program loads
void onStart() {

  if (voltage < 3) {
    lcd.begin(16, 2);
    lcd.print("AUTOMATIC SWITCH");
    lcd.setCursor(0, 1);
    lcd.print("ON LIGHTS:1,2,3");
  }
  if (voltage >= 3) {
    lcd.begin(16, 2);
    lcd.print("AUTOMATIC SWITCH");
    lcd.setCursor(0, 1);
    lcd.print("ON LIGHTS:NONE");
  }
}

